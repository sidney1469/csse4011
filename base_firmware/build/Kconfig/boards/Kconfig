## base_firmware/build/Kconfig/boards/Kconfig
```kconfig
# Load Zephyr board Kconfig descriptions.
osource "/home/sidney-neil/csse4011/zephyr/boards/seeed/xiao_ble/Kconfig"
```

## base_firmware/build/Kconfig/boards/Kconfig.defconfig
```kconfig
# Load Zephyr board defconfig descriptions.
osource "/home/sidney-neil/csse4011/zephyr/boards/seeed/xiao_ble/Kconfig.defconfig"
```

## firmware/build/Kconfig/Kconfig.shield.defconfig
```kconfig
osource "/home/sidney-neil/csse4011/firmware/boards/shields/*/Kconfig.defconfig"
```

## firmware/build/Kconfig/arch/Kconfig
```kconfig
# Load Zephyr Arch Kconfig descriptions.
osource "/home/sidney-neil/csse4011/zephyr/arch/rx/Kconfig"
osource "/home/sidney-neil/csse4011/zephyr/arch/x86/Kconfig"
osource "/home/sidney-neil/csse4011/zephyr/arch/xtensa/Kconfig"
osource "/home/sidney-neil/csse4011/zephyr/arch/sparc/Kconfig"
osource "/home/sidney-neil/csse4011/zephyr/arch/riscv/Kconfig"
osource "/home/sidney-neil/csse4011/zephyr/arch/posix/Kconfig"
osource "/home/sidney-neil/csse4011/zephyr/arch/mips/Kconfig"
osource "/home/sidney-neil/csse4011/zephyr/arch/arm64/Kconfig"
osource "/home/sidney-neil/csse4011/zephyr/arch/arm/Kconfig"
osource "/home/sidney-neil/csse4011/zephyr/arch/arc/Kconfig"
```

## firmware/build/Kconfig/boards/Kconfig.xiao_ble
```kconfig
# Load board Kconfig descriptions.
osource "/home/sidney-neil/csse4011/zephyr/boards/seeed/xiao_ble/Kconfig.xiao_ble"
```
