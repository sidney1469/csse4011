## CMakeLists.txt
```
cmake_minimum_required(VERSION 3.20.0)

find_package(Zephyr REQUIRED HINTS $ENV{ZEPHYR_BASE})
project(central)

target_sources(app PRIVATE
  src/main.c
  src/central.c
  src/parse.c
  src/shell.c
  src/sniffer.c
  lib/least_squares.c
  lib/kalman.c
  lib/matrix.c
)

zephyr_library_include_directories(${ZEPHYR_BASE}/samples/bluetooth)

target_include_directories(app PRIVATE
  ${CMAKE_CURRENT_SOURCE_DIR}/lib
  ${CMAKE_CURRENT_SOURCE_DIR}/src
)
```

## sample.yaml
```
sample:
  name: base_node
tests:
  sample.bluetooth.central:
    harness: bluetooth
    platform_allow:
      - qemu_cortex_m3
      - qemu_x86
    tags: bluetooth
    integration_platforms:
      - qemu_cortex_m3
  sample.bluetooth.central.no_blobs:
    extra_args:
      - CONFIG_BUILD_ONLY_NO_BLOBS=y
    platform_allow:
      - esp32_devkitc/esp32/procpu
      - esp32s3_devkitm/esp32s3/procpu
      - esp8684_devkitm
      - esp32c3_devkitm
      - esp32c6_devkitc/esp32c6/hpcore
      - esp32h2_devkitm
      - sltb010a/efr32bg22c224f512im40
      - xg24_rb4187c/efr32mg24b220f1536im48
      - xg27_dk2602a/efr32bg27c140f768im40
      - xg29_rb4412a/efr32mg29b140f1024im40
    build_only: true
```

## prj.conf
```kconfig
CONFIG_BT=y
CONFIG_BT_CENTRAL=y
CONFIG_BT_GATT_CLIENT=y
CONFIG_BT_ZEPHYR_NUS=y
CONFIG_JSON_LIBRARY=y
CONFIG_SHELL=y
CONFIG_SHELL_BACKEND_SERIAL=y
CONFIG_UART_CONSOLE=y
CONFIG_FPU=y
CONFIG_FPU_SHARING=y
CONFIG_CBPRINTF_FP_SUPPORT=y

CONFIG_HEAP_MEM_POOL_SIZE=4096
```

## src/main.c
```c
/*********************************** */
/*            main.c                 */
/*********************************** */
/* Authors                           */
/* Sidney Neil 47441952              */
/* Fiachra Richards  47450271        */
/*********************************** */

#include <zephyr/kernel.h>
#include "central.h"
#include "parse.h"
#include "shell.h"

/* Thread configuration */
#define CENTRAL_STACK_SIZE 2048
#define PARSE_STACK_SIZE   2048
#define PARSE_PRIORITY     5
#define CENTRAL_PRIORITY   5

/* Stack areas for application threads */
K_THREAD_STACK_DEFINE(central_stack_area, CENTRAL_STACK_SIZE);
K_THREAD_STACK_DEFINE(parse_stack_area, PARSE_STACK_SIZE);

/* Thread control blocks */
struct k_thread central_thread_data;
struct k_thread parse_thread_data;

/* Thread entry functions */
extern void central_thread(void *a, void *b, void *c);
extern void parse_thread(void *a, void *b, void *c);

int main(void)
{
    /* Initialise default beacon configuration before starting application threads */
    init_default_beacons();

    /* Start Bluetooth central thread */
    k_tid_t tid = k_thread_create(&central_thread_data, central_stack_area,
                                  K_THREAD_STACK_SIZEOF(central_stack_area), central_thread, NULL,
                                  NULL, NULL, CENTRAL_PRIORITY, 0, K_NO_WAIT);

    if (!tid) {
        printk("Failed to create central thread!\n");
    }

    /* Start packet parsing thread */
    k_tid_t tid2 = k_thread_create(&parse_thread_data, parse_stack_area,
                                   K_THREAD_STACK_SIZEOF(parse_stack_area), parse_thread, NULL,
                                   NULL, NULL, PARSE_PRIORITY, 0, K_NO_WAIT);

    if (!tid2) {
        printk("Failed to create parsing thread!\n");
    }

    return 0;
}
```

## src/central.c
```c
/*********************************** */
/*            central.c              */
/*********************************** */
/* Authors                           */
/* Sidney Neil 47441952              */
/* Fiachra Richards  47450271        */
/*********************************** */

/********* Include Libraries ******* */
#include <zephyr/types.h>
#include <stddef.h>
#include <errno.h>
#include <zephyr/kernel.h>
#include <zephyr/sys/printk.h>
#include <zephyr/bluetooth/bluetooth.h>
#include <zephyr/bluetooth/hci.h>
#include <zephyr/bluetooth/conn.h>
#include <zephyr/bluetooth/uuid.h>
#include <zephyr/bluetooth/gatt.h>
#include <zephyr/bluetooth/services/nus.h>
#include <zephyr/sys/byteorder.h>
#include "central.h"
#include "shell.h"
#include "sniffer.h"
/********************************* */

/*********** Global Defines ********** */

static void start_scan(void);

/* Active BLE connection used by the central device */
static struct bt_conn *default_conn;

/* Message queue for passing received Bluetooth data to the parser */
char data_msgq_buffer[10 * sizeof(struct bt_data_received)];
K_MSGQ_DEFINE(bt_data_msgq, sizeof(struct bt_data_received), 10, 4);

/* Stack allocation for sniffer mode thread */
K_THREAD_STACK_DEFINE(sniffer_stack_area, SNIFFER_STACK_SIZE);

/* Target peripheral MAC addresses */
static const bt_addr_t target_mac_1 = {.val = {0x65, 0xA9, 0xB3, 0x5F, 0x9A, 0xC5}};
static const bt_addr_t target_mac_2 = {.val = {0x15, 0xFB, 0xFA, 0xD7, 0xC4, 0xC1}};

/* Nordic UART Service UUIDs */
static struct bt_uuid_128 nus_svc_uuid = BT_UUID_INIT_128(BT_UUID_NUS_SRV_VAL);
static struct bt_uuid_128 nus_tx_uuid = BT_UUID_INIT_128(BT_UUID_NUS_TX_CHAR_VAL);
static struct bt_uuid_128 nus_rx_uuid = BT_UUID_INIT_128(BT_UUID_NUS_RX_CHAR_VAL);

/* GATT parameters must persist while discovery/subscription is active */
static struct bt_gatt_subscribe_params subscribe_params;
static struct bt_gatt_discover_params discover_params;

/*
 * Handles incoming NUS TX notifications.
 * Received data is copied into a queue so another thread can process it.
 */
static uint8_t on_received(struct bt_conn *conn, struct bt_gatt_subscribe_params *params,
                           const void *data, uint16_t length)
{
    if (!data) {
        printk("NUS TX unsubscribed\n");
        params->value_handle = 0;
        return BT_GATT_ITER_STOP;
    }

    const int8_t *bytes = (const uint8_t *)data;

    struct bt_data_received new_data = {0};
    uint16_t c = 0;

    for (int i = 0; i < length; i++) {
        new_data.data_buffer[i] = (int8_t)bytes[i];
        c++;
    }

    new_data.data_len = c;

    k_msgq_put(&bt_data_msgq, &new_data, K_NO_WAIT);

    return BT_GATT_ITER_CONTINUE;
}

/*
 * Performs GATT discovery for the Nordic UART Service.
 * Once the TX characteristic is found, notifications are enabled.
 */
static uint8_t discover_func(struct bt_conn *conn, const struct bt_gatt_attr *attr,
                             struct bt_gatt_discover_params *params)
{
    if (!attr) {
        printk("Discovery complete\n");
        return BT_GATT_ITER_STOP;
    }

    if (!bt_uuid_cmp(params->uuid, &nus_svc_uuid.uuid)) {
        params->uuid = NULL; // Discover all characteristics
        params->start_handle = attr->handle + 1;
        params->type = BT_GATT_DISCOVER_CHARACTERISTIC;
        bt_gatt_discover(conn, params);
        return BT_GATT_ITER_STOP;
    }

    struct bt_gatt_chrc *chrc = (struct bt_gatt_chrc *)attr->user_data;

    if (!bt_uuid_cmp(chrc->uuid, &nus_tx_uuid.uuid)) {
        printk("Found NUS TX Characteristic\n");

        subscribe_params.notify = on_received;
        subscribe_params.value = BT_GATT_CCC_NOTIFY;
        subscribe_params.value_handle = chrc->value_handle;
        subscribe_params.ccc_handle = chrc->value_handle + 1;

        int err = bt_gatt_subscribe(conn, &subscribe_params);
        if (err) {
            printk("Subscribe failed: %d\n", err);
        } else {
            printk("Subscribed to NUS TX\n");
        }
    }

    else if (!bt_uuid_cmp(chrc->uuid, &nus_rx_uuid.uuid)) {
        printk("Found NUS RX Characteristic (Phone can write to this)\n");
    }

    return BT_GATT_ITER_CONTINUE;
}

/* Starts service discovery on the connected peripheral */
static void start_discovery(struct bt_conn *conn)
{
    discover_params.uuid = &nus_svc_uuid.uuid;
    discover_params.func = discover_func;
    discover_params.start_handle = BT_ATT_FIRST_ATTRIBUTE_HANDLE;
    discover_params.end_handle = BT_ATT_LAST_ATTRIBUTE_HANDLE;
    discover_params.type = BT_GATT_DISCOVER_PRIMARY;

    int err = bt_gatt_discover(conn, &discover_params);
    if (err) {
        printk("Discovery failed to start: %d\n", err);
    }
}

/*
 * Scan callback for central mode.
 * Filters discovered devices by advertisement type and target MAC address.
 */
static void device_found(const bt_addr_le_t *addr, int8_t rssi, uint8_t type,
                         struct net_buf_simple *ad)
{
    char addr_str[BT_ADDR_LE_STR_LEN];
    int err;

    if (default_conn) {
        return;
    }

    if (type != BT_GAP_ADV_TYPE_ADV_IND && type != BT_GAP_ADV_TYPE_ADV_DIRECT_IND) {
        return;
    }

    if ((bt_addr_cmp(&addr->a, &target_mac_1) != 0) &&
        (bt_addr_cmp(&addr->a, &target_mac_2) != 0)) {
        return;
    }

    bt_addr_le_to_str(addr, addr_str, sizeof(addr_str));
    printk("Target found: %s (RSSI %d)\n", addr_str, rssi);

    if (bt_le_scan_stop()) {
        return;
    }

    err = bt_conn_le_create(addr, BT_CONN_LE_CREATE_CONN, BT_LE_CONN_PARAM_DEFAULT, &default_conn);
    if (err) {
        printk("Create conn failed: %d\n", err);
        start_scan();
    }
}

/* Starts passive BLE scanning in central mode */
static void start_scan(void)
{
    int err = bt_le_scan_start(BT_LE_SCAN_PASSIVE, device_found);
    if (err) {
        printk("Scanning failed to start: %d\n", err);
        return;
    }

    printk("Scanning started\n");
}

/* ── Connection callbacks ────────────────────────────────────────────────── */

/* Handles successful and failed BLE connection attempts */
static void connected(struct bt_conn *conn, uint8_t err)
{
    char addr[BT_ADDR_LE_STR_LEN];
    bt_addr_le_to_str(bt_conn_get_dst(conn), addr, sizeof(addr));

    if (err) {
        printk("Failed to connect to %s: %u %s\n", addr, err, bt_hci_err_to_str(err));
        bt_conn_unref(default_conn);
        default_conn = NULL;
        start_scan();
        return;
    }

    if (conn != default_conn) {
        return;
    }

    printk("Connected: %s\n", addr);
    start_discovery(conn);
}

/* Cleans up the active connection and returns to scanning */
static void disconnected(struct bt_conn *conn, uint8_t reason)
{
    char addr[BT_ADDR_LE_STR_LEN];

    if (conn != default_conn) {
        return;
    }

    bt_addr_le_to_str(bt_conn_get_dst(conn), addr, sizeof(addr));
    printk("Disconnected: %s, reason 0x%02x %s\n", addr, reason, bt_hci_err_to_str(reason));

    bt_conn_unref(default_conn);
    default_conn = NULL;

    start_scan();
}

/* Register connection callbacks with the Zephyr Bluetooth stack */
BT_CONN_CB_DEFINE(conn_callbacks) = {
    .connected = connected,
    .disconnected = disconnected,
};

/* ── Thread entry ────────────────────────────────────────────────────────── */

k_tid_t tid;
int enabled = 0;

/* Registers scan callbacks used by sniffer mode */
void sniffer_cb_register(void)
{
    bt_le_scan_cb_register(&scan_callbacks);
}

/* Default passive scan parameters */
struct bt_le_scan_param scan_param = {
    .type = BT_LE_SCAN_TYPE_PASSIVE,
    .options = BT_LE_SCAN_OPT_FILTER_DUPLICATE,
    .interval = 0x0100,
    .window = BT_GAP_SCAN_FAST_WINDOW,
};

/*
 * Main Bluetooth thread.
 * Runs in central mode by default and switches to sniffer mode when requested.
 */
void central_thread(void *a, void *b, void *c)
{
    int err = bt_enable(NULL);
    if (err) {
        printk("Bluetooth init failed: %d\n", err);
        return;
    }

    printk("Bluetooth initialized\n");
    start_scan();

    while (1) {
        if (sniffer) {
            if (!enabled) {
                bt_le_scan_stop();
                bt_disable();

                err = bt_enable(NULL);
                if (err) {
                    printk("BT re-enable failed: %d\n", err);
                    k_sleep(K_MSEC(1000));
                    continue;
                }

                bt_le_scan_cb_register(&scan_callbacks);

                /* Sniffer mode uses scan callbacks instead of the central device_found callback */
                struct bt_le_scan_param scan_param = {
                    .type = BT_LE_SCAN_TYPE_PASSIVE,
                    .options = BT_LE_SCAN_OPT_NONE,
                    .interval = 0x0100,
                    .window = BT_GAP_SCAN_FAST_WINDOW,
                };

                bt_le_scan_start(&scan_param, NULL);

                tid = k_thread_create(&sniffer_thread_data, sniffer_stack_area,
                                      K_THREAD_STACK_SIZEOF(sniffer_stack_area), sniffer_thread,
                                      NULL, NULL, NULL, SNIFFER_PRIORITY, 0, K_NO_WAIT);

                enabled = 1;
                printk("Sniffer mode enabled\n");
            }
        } else {
            if (enabled) {
                k_thread_abort(tid);
                enabled = 0;
                tid = 0;

                bt_le_scan_stop();
                bt_disable();

                err = bt_enable(NULL);
                if (err) {
                    printk("BT re-enable failed: %d\n", err);
                    k_sleep(K_MSEC(1000));
                    continue;
                }

                start_scan();
                printk("Central mode enabled\n");
            }
        }

        k_sleep(K_MSEC(1000));
    }
}
```

## src/central.h
```c
/*********************************** */
/*            central.h              */
/*********************************** */
/* Authors                           */
/* Sidney Neil 47441952              */
/* Fiachra Richards  47450271        */
/*********************************** */

#ifndef CENTRAL_H
#define CENTRAL_H

#include <stddef.h>
#include <zephyr/kernel.h>

/* Maximum payload length for received NUS Bluetooth data */
#define NUS_MAX_DATA_LEN 13

/*
 * Stores a received Bluetooth data packet.
 * data_len indicates how many bytes in data_buffer are valid.
 */
struct bt_data_received {
    size_t data_len;
    int8_t data_buffer[NUS_MAX_DATA_LEN];
};

/* Shared message queue for passing received Bluetooth data to other threads */
extern struct k_msgq bt_data_msgq;

/* Thread entry point for the Bluetooth central module */
void central_thread(void *a, void *b, void *c);

/* Registers BLE scan callbacks used when running in sniffer mode */
void sniffer_cb_register(void);

#endif /* CENTRAL_H */
```

## src/kalman.c
```c
#include <stdio.h>
#include <stdlib.h>
#include <math.h>
#include <string.h>
#include <zephyr/types.h>
#include <zephyr/kernel.h>
#include <stddef.h>
#include "kalman.h"

extern struct k_msgq kalman_data_msgq;

K_MSGQ_DEFINE(kalman_data_msgq, sizeof(struct kalman_struct), 10, 4);

int calculate_kalman(int8_t value, float out) {

    float Q = 0.022f;
    float R = 0.617f;

    float K;
    float P_temp;
    float x_est;

    struct kalman_struct newdata;

    if (k_msgq_get(&kalman_data_msgq, &newdata, K_NO_WAIT) != 0) {
        return -1;
    }

    float last_value;
    float P_last;

    last_value = (float)newdata.last_value;
    P_last     = (float)newdata.P_last;
    

    float P_data;

    P_temp  = P_last + Q;
    K       = P_temp * (1.0f / (P_temp + R));
    x_est   = last_value + K * ((float)value - last_value);
    P_data = (1.0f - K) * P_temp;

    out = (int8_t)x_est;
    
    newdata.last_value = out;
    newdata.P_last     = (int8_t)P_data;

    if (k_msgq_put(&kalman_data_msgq, &newdata, K_NO_WAIT) != 0) {
        return -2;
    }

    return 0;
}
```

## src/kalman.h
```c
#ifndef KALMAN_H
#define KALMAN_H

#include <zephyr/kernel.h>
#include <zephyr/types.h>

struct kalman_struct {
    int8_t last_value;
    int8_t P_last;
};

extern struct k_msgq kalman_data_msgq;

int calculate_kalman(int8_t value, float out);

#endif /* KALMAN_H */
```

## src/least_squares.c
```c
#include <stdio.h>
#include <math.h>
#include <string.h>

#define N_BEACONS 13
#define N_AXIS    3
#define N_ROWS    N_BEACONS - 1
#define N_COLS    N_AXIS

void transpose_matrix(float *A, float *At, int rowsA, int colsA)
{
    for (int i = 0; i < rowsA; i++) {
        for (int j = 0; j < colsA; j++) {
            At[j * rowsA + i] = A[i * colsA + j]
        }
    }
}

void multiply_matrix(float *A, float *B, float *C, int rowsA, int colsA, int colsB)
{
    for (int i = 0; i < rowsA; i++) {
        for (int j = 0; j < colsB; j++) {
            C[i * colsB + j] = 0.0f;
            for (int k = 0; k < colsA; k++) {
                C[i * colsB + j] += A[i * colsA + k] * B[k * colsB + j];
            }
        }
    }
}

void build_Ab(float beacon_coords[N_BEACONS][N_AXIS], float displacements[N_BEACONS],
              float A[N_ROWS][N_COLS], float b[N_ROWS])
{
    float xk = beacon_coords[12][0];
    float yk = beacon_coords[12][1];
    float zk = beacon_coords[12][2];
    float rk = displacements[12];

    for (int i = 0; i < N_ROWS; i++) {
        float xi = beacon_coords[i][0];
        float yi = beacon_coords[i][1];
        float zi = beacon_coords[i][2];
        float ri = displacements[i];

        A[i][0] = 2.0f * (xk - xi);
        A[i][1] = 2.0f * (yk - yi);
        A[i][2] = 2.0f * (zk - zi);

        b[i] = ri * ri - rk * rk - xi * xi + xk * xk - yi * yi + yk * yk - zi * zi + zk * zk;
    }
}

int invert_3x3_matrix(float M[3][3], float inv[3][3])
{
    float det = M[0][0] * (M[1][1] * M[2][2] - M[1][2] * M[2][1]) -
                M[0][1] * (M[1][0] * M[2][2] - M[1][2] * M[2][0]) +
                M[0][2] * (M[1][0] * M[2][1] - M[1][1] * M[2][0]);

    if (fabsf(det) < 1e-6f) {
        return -1;
    }

    float inv_det = 1.0f / det;

    inv[0][0] = (M[1][1] * M[2][2] - M[1][2] * M[2][1]) * inv_det;
    inv[0][1] = -(M[0][1] * M[2][2] - M[0][2] * M[2][1]) * inv_det;
    inv[0][2] = (M[0][1] * M[1][2] - M[0][2] * M[1][1]) * inv_det;
    inv[1][0] = -(M[1][0] * M[2][2] - M[1][2] * M[2][0]) * inv_det;
    inv[1][1] = (M[0][0] * M[2][2] - M[0][2] * M[2][0]) * inv_det;
    inv[1][2] = -(M[0][0] * M[1][2] - M[0][2] * M[1][0]) * inv_det;
    inv[2][0] = (M[1][0] * M[2][1] - M[1][1] * M[2][0]) * inv_det;
    inv[2][1] = -(M[0][0] * M[2][1] - M[0][1] * M[2][0]) * inv_det;
    inv[2][2] = (M[0][0] * M[1][1] - M[0][1] * M[1][0]) * inv_det;

    return 0;
}

int lstsq_solve(float A[N_ROWS][N_COLS], float b[N_ROWS], float pos[N_COLS])
{

    // At = Aᵀ  (3x12)
    float At[N_COLS * N_ROWS];
    mat_transpose((float *)A, At, N_ROWS, N_COLS);

    // AtA = Aᵀ * A  (3x3)
    float AtA[N_COLS * N_COLS];
    mat_multiply(At, (float *)A, AtA, N_COLS, N_ROWS, N_COLS);

    // Atb = Aᵀ * b  (3x1)
    float Atb[N_COLS];
    mat_multiply(At, b, Atb, N_COLS, N_ROWS, 1);

    // invert AtA
    float AtA_inv[N_COLS][N_COLS];
    if (invert_3x3((float (*)[3])AtA, AtA_inv) != 0) {
        pos[0] = pos[1] = pos[2] = 0.0f;
        return -1;
    }

    // pos = AtA_inv * Atb  (3x1)
    mat_multiply((float *)AtA_inv, Atb, pos, N_COLS, N_COLS, 1);

    return 0;
}
```

## src/parse.c
```c
/*********************************** */
/*            parse.c                */
/*********************************** */
/* Authors                           */
/* Sidney Neil 47441952              */
/* Fiachra Richards  47450271        */
/*********************************** */

#include <stdlib.h>
#include <string.h>
#include <math.h>
#include <zephyr/data/json.h>
#include <zephyr/kernel.h>
#include <zephyr/types.h>
#include <stddef.h>
#include <errno.h>
#include <zephyr/sys/printk.h>

#include "parse.h"
#include "central.h"
#include "shell.h"
#include "kalman.h"
#include "least_squares.h"

/* JSON description used to encode localisation results for output */
static const struct json_obj_descr data_send_descr[] = {
    JSON_OBJ_DESCR_ARRAY(struct data_send, data_buffer, NUS_MAX_DATA_LEN, data_len, JSON_TOK_INT),
    JSON_OBJ_DESCR_PRIM(struct data_send, raw_pos_x, JSON_TOK_NUMBER),
    JSON_OBJ_DESCR_PRIM(struct data_send, raw_pos_y, JSON_TOK_NUMBER),
    JSON_OBJ_DESCR_PRIM(struct data_send, filtered_pos_x, JSON_TOK_NUMBER),
    JSON_OBJ_DESCR_PRIM(struct data_send, filtered_pos_y, JSON_TOK_NUMBER),
    JSON_OBJ_DESCR_PRIM(struct data_send, velocity_x, JSON_TOK_NUMBER),
    JSON_OBJ_DESCR_PRIM(struct data_send, velocity_y, JSON_TOK_NUMBER),
    JSON_OBJ_DESCR_PRIM(struct data_send, timestamp, JSON_TOK_INT64),
};

/*
 * Converts received Bluetooth data and localisation results into JSON.
 * Position and velocity values are scaled before encoding to avoid sending floats.
 */
void parse_data_into_json(struct bt_data_received data, float raw_pos[N_AXIS],
                          float filtered_pos[N_AXIS], float velocity[N_AXIS], int64_t timestamp)
{
    struct data_send send;
    char buffer[256];

    memcpy(send.data_buffer, data.data_buffer, sizeof(send.data_buffer));

    send.data_len = data.data_len;
    send.raw_pos_x = (int32_t)(raw_pos[0] * 100);
    send.raw_pos_y = (int32_t)(raw_pos[1] * 100);
    send.filtered_pos_x = (int32_t)(filtered_pos[0] * 100);
    send.filtered_pos_y = (int32_t)(filtered_pos[1] * 100);
    send.velocity_x = (int32_t)(velocity[0] * 100);
    send.velocity_y = (int32_t)(velocity[1] * 100);
    send.timestamp = (int64_t)(timestamp);

    json_obj_encode_buf(data_send_descr, ARRAY_SIZE(data_send_descr), &send, buffer,
                        sizeof(buffer));
    printk("%s\n", buffer);
}

/*
 * Parser thread for received Bluetooth data.
 * RSSI data is converted into a raw position estimate, then filtered using
 * the Kalman filter before being output as JSON.
 */
void parse_thread(void *a, void *b, void *c)
{
    struct bt_data_received data;

    float coords[N_BEACONS][N_AXIS];
    float raw_pos[N_AXIS];
    float filtered_pos[N_AXIS];
    float velocity[N_AXIS];

    bool filter_initialised = false;
    int64_t last_time_ms = k_uptime_get();
    int64_t curr_time_ms;
    float dt;

    while (1) {
        /* Wait for new Bluetooth data from the central thread */
        k_msgq_get(&bt_data_msgq, &data, K_FOREVER);

        curr_time_ms = k_uptime_get();

        dt = (curr_time_ms - last_time_ms) / 1000.0f;

        // Clamp in the case that msgq waiting has taken a long time
        if (dt > 0.5f) {
            dt = 0.5f;
        }

        last_time_ms = curr_time_ms;

        /* Load the current beacon coordinates configured through the shell */
        get_beacons_coords(coords, N_BEACONS);

        /* Disable RSSI readings for beacons that have not been configured */
        for (int i = 0; i < N_BEACONS; i++) {
            if (coords[i][0] == -1.0f) {
                data.data_buffer[i] = 0;
            }
        }

        /* Estimate position from beacon coordinates and RSSI values */
        int beacons_used =
            localise(coords, data.data_buffer, MEASURED_POWER, PATH_LOSS_EXP, raw_pos);

        if (beacons_used == -1 || (isnan(raw_pos[0]) || isnan(raw_pos[1]))) {
            printk("Localisation failed\n");
            continue;
        } else {
            printk("Localisation successful. Estimated position using %d nodes\n", beacons_used);

            if (raw_pos[0] > 10.0f) {
                raw_pos[0] = 10.0f;
            }
            if (raw_pos[0] < -2.0f) {
                raw_pos[0] = -2.0f;
            }
            if (raw_pos[1] > 6.0f) {
                raw_pos[1] = 6.0f;
            }
            if (raw_pos[1] < -2.0f) {
                raw_pos[1] = -2.0f;
            }

            if (filter_initialised) {
                kalman_predict(dt);
                kalman_update(raw_pos[0], raw_pos[1]);
                kalman_get_position(&filtered_pos[0], &filtered_pos[1]);
                kalman_get_velocity(&velocity[0], &velocity[1]);

                parse_data_into_json(data, raw_pos, filtered_pos, velocity, curr_time_ms);
            } else {
                /* Initialise the filter with the first valid position estimate */
                init_filter(raw_pos[0], raw_pos[1]);
                filter_initialised = true;
            }
        }
    }
}
```

## src/parse.h
```c
/*********************************** */
/*            parse.h                */
/*********************************** */
/* Authors                           */
/* Sidney Neil 47441952              */
/* Fiachra Richards  47450271        */
/*********************************** */

#ifndef PARSE_H
#define PARSE_H

#include <stddef.h>

#include "central.h"

/* RSSI path-loss model constants used for distance estimation */
#define PATH_LOSS_EXP  3.0f
#define MEASURED_POWER -56.0f

/* Thread entry point for parsing received Bluetooth data */
void parse_thread(void *a, void *b, void *c);

/*
 * Data format used when sending localisation results as JSON.
 * Position and velocity values are scaled by 100 before being stored.
 */
struct data_send {
    int8_t data_buffer[NUS_MAX_DATA_LEN];
    size_t data_len;

    int32_t raw_pos_x;      // float value * 100
    int32_t raw_pos_y;
    int32_t filtered_pos_x;
    int32_t filtered_pos_y;
    int32_t velocity_x;
    int32_t velocity_y;

    int64_t timestamp;
};

#endif /* PARSE_H */
```

## src/shell.c
```c
/*********************************** */
/*             shell.c               */
/*********************************** */
/* Authors                           */
/* Sidney Neil 47441952              */
/* Fiachra Richards  47450271        */
/*********************************** */

/********* Include Libraries ******* */
#include <zephyr/kernel.h>
#include <zephyr/shell/shell.h>
#include <zephyr/sys/slist.h>
#include <stdlib.h>
#include "shell.h"
/********************************* */

/*
 * Default iBeacon configuration used to initialise the system.
 * Each beacon stores its ID information, position, and neighbouring nodes.
 */
static const struct {
    char name[32];
    char mac[18];
    uint16_t major;
    uint16_t minor;
    float x;
    float y;
    char left_neighbour[32];
    char right_neighbour[32];
} defaults[13] = {
    {"4011-A", "F5:75:FE:85:34:67", 2753, 32998, 0, 0, "", "4011-B"},
    {"4011-B", "E5:73:87:06:1E:86", 32975, 20959, 0, 1.7, "4011-A", "4011-C"},
    {"4011-C", "CA:99:9E:FD:98:B1", 26679, 40363, 0, 3.4, "4011-B", "4011-D"},
    {"4011-D", "CB:1B:89:82:FF:FE", 41747, 38800, 1.75, 3.4, "4011-C", "4011-E"},
    {"4011-E", "D4:D2:A0:A4:5C:AC", 30679, 51963, 3.5, 3.4, "4011-D", "4011-F"},
    {"4011-F", "C1:13:27:E9:B7:7C", 6195, 18394, 5.25, 3.4, "4011-E", "4011-G"},
    {"4011-G", "F1:04:48:06:39:A0", 30525, 30544, 7, 3.4, "4011-F", "4011-H"},
    {"4011-H", "CA:0C:E0:DB:CE:60", 57395, 28931, 7, 1.7, "4011-G", "4011-I"},
    {"4011-I", "D4:7F:D4:7C:20:13", 60345, 49995, 7, 0, "4011-H", "4011-J"},
    {"4011-J", "F7:0B:21:F1:C8:E1", 12249, 30916, 5.25, 0, "4011-I", "4011-K"},
    {"4011-K", "FD:E0:8D:FA:3E:4A", 36748, 11457, 3.5, 0, "4011-J", "4011-L"},
    {"4011-L", "EE:32:F7:28:FA:AC", 27564, 27589, 1.75, 0, "4011-K", "4011-A"},
    {"4011-M", "F7:3B:46:A8:D7:2C", 49247, 52925, 3.5, 1.7, "", ""},
};

/* Linked list used to store active beacon nodes */
sys_slist_t beacon_list = SYS_SLIST_STATIC_INIT(&beacon_list);

/* Global flag used to toggle between central mode and sniffer mode */
int sniffer = 0;

/* Adds a new iBeacon node to the beacon list from shell arguments */
static int cmd_beacon_add(const struct shell *sh, size_t argc, char **argv)
{
    struct ibeacon_node *node = k_malloc(sizeof(struct ibeacon_node));
    if (!node) {
        shell_error(sh, "Out of memory");
        return -ENOMEM;
    }

    strncpy(node->name, argv[1], sizeof(node->name) - 1);
    strncpy(node->mac, argv[2], sizeof(node->mac) - 1);
    node->major = atoi(argv[3]);
    node->minor = atoi(argv[4]);
    node->x = atof(argv[5]);
    node->y = atof(argv[6]);

    strncpy(node->left_neighbour, argv[8], sizeof(node->left_neighbour) - 1);
    strncpy(node->right_neighbour, argv[9], sizeof(node->right_neighbour) - 1);

    sys_slist_append(&beacon_list, &node->node);
    shell_print(sh, "Added beacon: %s at (%.1f, %.1f)", node->name, (double)node->x,
                (double)node->y);

    return 0;
}

/* Removes an iBeacon node from the beacon list by name */
static int cmd_beacon_remove(const struct shell *sh, size_t argc, char **argv)
{
    struct ibeacon_node *node;
    struct ibeacon_node *tmp;

    SYS_SLIST_FOR_EACH_CONTAINER_SAFE(&beacon_list, node, tmp, node) {
        if (strcmp(node->name, argv[1]) == 0) {
            sys_slist_find_and_remove(&beacon_list, &node->node);
            k_free(node);
            shell_print(sh, "Removed beacon: %s", argv[1]);
            return 0;
        }
    }

    shell_error(sh, "Beacon not found: %s", argv[1]);
    return -ENOENT;
}

/* Toggles sniffer mode on or off */
static int cmd_beacon_sniffer(const struct shell *sh, size_t argc, char **argv)
{
    sniffer ^= 1;
    printk(sniffer ? "enabled" : "disabled");
    return 0;
}

/* Displays either one beacon or all beacons currently stored in the list */
static int cmd_beacon_view(const struct shell *sh, size_t argc, char **argv)
{
    struct ibeacon_node *node;

    bool view_all = (strcmp(argv[1], "-a") == 0);

    SYS_SLIST_FOR_EACH_CONTAINER(&beacon_list, node, node) {
        if (view_all || strcmp(node->name, argv[1]) == 0) {
            shell_print(sh, "----------------------------");
            shell_print(sh, "Name:    %s", node->name);
            shell_print(sh, "MAC:     %s", node->mac);
            shell_print(sh, "Major:   %d", node->major);
            shell_print(sh, "Minor:   %d", node->minor);
            shell_print(sh, "Pos:     (%.1f, %.1f)", (double)node->x, (double)node->y);
            shell_print(sh, "Left:    %s", node->left_neighbour);
            shell_print(sh, "Right:   %s", node->right_neighbour);

            if (!view_all) {
                return 0;
            }
        }
    }

    return 0;
}

/* Loads the default beacon configuration into the linked list */
void init_default_beacons(void)
{
    for (int i = 0; i < 13; i++) {
        struct ibeacon_node *node = k_malloc(sizeof(struct ibeacon_node));
        if (!node) {
            printk("beacon_init_defaults: out of memory at %d\n", i);
            return;
        }

        strncpy(node->name, defaults[i].name, sizeof(node->name) - 1);
        strncpy(node->mac, defaults[i].mac, sizeof(node->mac) - 1);
        node->major = defaults[i].major;
        node->minor = defaults[i].minor;
        node->x = defaults[i].x;
        node->y = defaults[i].y;
        strncpy(node->left_neighbour, defaults[i].left_neighbour, sizeof(node->left_neighbour) - 1);
        strncpy(node->right_neighbour, defaults[i].right_neighbour,
                sizeof(node->right_neighbour) - 1);

        sys_slist_append(&beacon_list, &node->node);
    }

    printk("Beacon list initialised with 13 nodes\n");
}

/*
 * Copies beacon coordinates from the linked list into an indexed array.
 * Missing beacons are initialised to -1.0f so they can be ignored later.
 */
int get_beacons_coords(float coords[][2], int max_beacons)
{
    for (int i = 0; i < max_beacons; i++) {
        coords[i][0] = coords[i][1] = -1.0f;
    }

    struct ibeacon_node *node;
    int found = 0;

    SYS_SLIST_FOR_EACH_CONTAINER(&beacon_list, node, node) {
        int idx = node->name[5] - 'A';
        if (idx < 0 || idx >= max_beacons) {
            continue;
        }

        coords[idx][0] = node->x;
        coords[idx][1] = node->y;
        found++;
    }

    return found;
}

/* Shell command registration for beacon management */
SHELL_STATIC_SUBCMD_SET_CREATE(
    sub_beacon,
    SHELL_CMD_ARG(add, NULL,
                  "Add ibeacon node.\n"
                  "Usage: beacon add <name> <mac> <major> <minor> <x> <y> <left> <right>",
                  cmd_beacon_add, 9, 0),
    SHELL_CMD_ARG(remove, NULL,
                  "Remove ibeacon node.\n"
                  "Usage: beacon remove <name>",
                  cmd_beacon_remove, 2, 0),
    SHELL_CMD_ARG(view, NULL,
                  "View ibeacon node(s).\n"
                  "Usage: beacon view <name> | beacon view -a",
                  cmd_beacon_view, 2, 0),
    SHELL_CMD_ARG(sniffer, NULL,
                  "Toggle Sniffer Node.\n"
                  "Usage: beacon sniffer",
                  cmd_beacon_sniffer, 1, 0),
    SHELL_SUBCMD_SET_END);

/* Register the top-level beacon shell command */
SHELL_CMD_REGISTER(beacon, &sub_beacon, "Ibeacon node management", NULL);
```

## src/shell.h
```c
/*********************************** */
/*             shell.h               */
/*********************************** */
/* Authors                           */
/* Sidney Neil 47441952              */
/* Fiachra Richards  47450271        */
/*********************************** */

#ifndef SHELL_H
#define SHELL_H

#include <zephyr/sys/slist.h>
#include <stdint.h>

/*
 * Represents a configured iBeacon node.
 * Each node stores beacon identifiers, position, and neighbouring beacon names.
 */
struct ibeacon_node {
    sys_snode_t node;
    char name[32];
    char mac[18];
    uint16_t major;
    uint16_t minor;
    float x;
    float y;
    char left_neighbour[32];
    char right_neighbour[32];
};

/* Shared beacon list and sniffer mode flag */
extern sys_slist_t beacon_list;
extern int sniffer;

/* Beacon management functions */
struct ibeacon_node *beacon_find(const char *name);
int beacon_add(const char *name, const char *mac, uint16_t major, uint16_t minor, float x, float y,
               const char *left, const char *right);
int beacon_remove(const char *name);
void beacon_print(struct ibeacon_node *node);

/* Beacon coordinate access and default initialisation */
int get_beacons_coords(float coords[][2], int max_beacons);
void init_default_beacons(void);

#endif /* SHELL_H */
```

## src/sniffer.c
```c
/*********************************** */
/*            sniffer.c              */
/*********************************** */
/* Authors                           */
/* Sidney Neil 47441952              */
/* Fiachra Richards  47450271        */
/*********************************** */

/********* Include Libraries ******* */
#include <zephyr/sys/printk.h>
#include <zephyr/bluetooth/bluetooth.h>
#include <zephyr/bluetooth/hci.h>
#include <zephyr/bluetooth/gap.h>
#include <string.h>
#include "shell.h"
#include "central.h"
#include "parse.h"
/********************************* */

/*********** Global Defines ********** */

/* Time before a discovered node is considered inactive */
#define NODE_TIMEOUT_MS 3000

/* List of known BLE beacon node addresses to track in sniffer mode */
static const bt_addr_le_t nodelist[] = {
    {.type = BT_ADDR_LE_RANDOM, .a = {{0x67, 0x34, 0x85, 0xFE, 0x75, 0xF5}}},
    {.type = BT_ADDR_LE_RANDOM, .a = {{0x86, 0x1E, 0x06, 0x87, 0x73, 0xE5}}},
    {.type = BT_ADDR_LE_RANDOM, .a = {{0xB1, 0x98, 0xFD, 0x9E, 0x99, 0xCA}}},
    {.type = BT_ADDR_LE_RANDOM, .a = {{0xFE, 0xFF, 0x82, 0x89, 0x1B, 0xCB}}},
    {.type = BT_ADDR_LE_RANDOM, .a = {{0xAC, 0x5C, 0xA4, 0xA0, 0xD2, 0xD4}}},
    {.type = BT_ADDR_LE_RANDOM, .a = {{0x7C, 0xB7, 0xE9, 0x27, 0x13, 0xC1}}},
    {.type = BT_ADDR_LE_RANDOM, .a = {{0xA0, 0x39, 0x06, 0x48, 0x04, 0xF1}}},
    {.type = BT_ADDR_LE_RANDOM, .a = {{0x60, 0xCE, 0xDB, 0xE0, 0x0C, 0xCA}}},
    {.type = BT_ADDR_LE_RANDOM, .a = {{0x13, 0x20, 0x7C, 0xD4, 0x7F, 0xD4}}},
    {.type = BT_ADDR_LE_RANDOM, .a = {{0xE1, 0xC8, 0xF1, 0x21, 0x0B, 0xF7}}},
    {.type = BT_ADDR_LE_RANDOM, .a = {{0x4A, 0x3E, 0xFA, 0x8D, 0xE0, 0xFD}}},
    {.type = BT_ADDR_LE_RANDOM, .a = {{0xAC, 0xFA, 0x28, 0xF7, 0x32, 0xEE}}},
    {.type = BT_ADDR_LE_RANDOM, .a = {{0x2C, 0xD7, 0xA8, 0x46, 0x3B, 0xF7}}},
};

/* Stores the address and RSSI value from a scanned BLE node */
struct scan_result {
    bt_addr_le_t addr;
    int8_t rssi;
};

/* Queue used to pass filtered scan results to other application code */
K_MSGQ_DEFINE(scan_msgq, sizeof(struct scan_result), 30, 4);

/* Checks whether a scanned BLE address belongs to one of the known beacon nodes */
static bool addr_match(const bt_addr_le_t *addr)
{
    for (int i = 0; i < ARRAY_SIZE(nodelist); i++) {
        if (bt_addr_le_cmp(addr, &nodelist[i]) == 0) {
            return true;
        }
    }

    return false;
}

/* Converts BLE advertisement type values into readable strings */
static const char *adv_type_str(uint8_t type)
{
    switch (type) {
    case BT_GAP_ADV_TYPE_ADV_IND:
        return "ADV_IND: connectable + scannable";
    case BT_GAP_ADV_TYPE_ADV_DIRECT_IND:
        return "ADV_DIRECT_IND: directed connectable";
    case BT_GAP_ADV_TYPE_ADV_SCAN_IND:
        return "ADV_SCAN_IND: scannable";
    case BT_GAP_ADV_TYPE_ADV_NONCONN_IND:
        return "ADV_NONCONN_IND: non-connectable";
    case BT_GAP_ADV_TYPE_SCAN_RSP:
        return "SCAN_RSP";
    case BT_GAP_ADV_TYPE_EXT_ADV:
        return "EXT_ADV";
    default:
        return "UNKNOWN";
    }
}

/* Converts BLE PHY values into readable strings */
static const char *phy_str(uint8_t phy)
{
    switch (phy) {
    case BT_GAP_LE_PHY_NONE:
        return "none";
    case BT_GAP_LE_PHY_1M:
        return "LE 1M";
    case BT_GAP_LE_PHY_2M:
        return "LE 2M";
    case BT_GAP_LE_PHY_CODED:
        return "LE coded";
#ifdef BT_GAP_LE_PHY_CODED_S8
    case BT_GAP_LE_PHY_CODED_S8:
        return "LE coded S=8";
#endif
#ifdef BT_GAP_LE_PHY_CODED_S2
    case BT_GAP_LE_PHY_CODED_S2:
        return "LE coded S=2";
#endif
    default:
        return "unknown";
    }
}

/* Converts BLE advertising data field types into readable strings */
static const char *ad_type_str(uint8_t type)
{
    switch (type) {
    case BT_DATA_FLAGS:
        return "FLAGS";
    case BT_DATA_UUID16_SOME:
        return "UUID16_SOME";
    case BT_DATA_UUID16_ALL:
        return "UUID16_ALL";
    case BT_DATA_UUID32_SOME:
        return "UUID32_SOME";
    case BT_DATA_UUID32_ALL:
        return "UUID32_ALL";
    case BT_DATA_UUID128_SOME:
        return "UUID128_SOME";
    case BT_DATA_UUID128_ALL:
        return "UUID128_ALL";
    case BT_DATA_NAME_SHORTENED:
        return "NAME_SHORTENED";
    case BT_DATA_NAME_COMPLETE:
        return "NAME_COMPLETE";
    case BT_DATA_TX_POWER:
        return "TX_POWER";
    case BT_DATA_SOLICIT16:
        return "SOLICIT16";
    case BT_DATA_SOLICIT128:
        return "SOLICIT128";
    case BT_DATA_SVC_DATA16:
        return "SVC_DATA16";
    case BT_DATA_GAP_APPEARANCE:
        return "GAP_APPEARANCE";
    case BT_DATA_MANUFACTURER_DATA:
        return "MANUFACTURER_DATA";
    case BT_DATA_SVC_DATA32:
        return "SVC_DATA32";
    case BT_DATA_SVC_DATA128:
        return "SVC_DATA128";
    default:
        return "UNKNOWN_AD_TYPE";
    }
}

/* Prints raw byte data in hexadecimal format */
static void print_hex_bytes(const uint8_t *data, uint8_t len)
{
    for (uint8_t i = 0; i < len; i++) {
        printk("%02x", data[i]);

        if (i + 1 < len) {
            printk(" ");
        }
    }
}

/*
 * Callback used by bt_data_parse().
 * Prints each advertising data field and decodes common field types.
 */
static bool print_ad_field(struct bt_data *data, void *user_data)
{
    ARG_UNUSED(user_data);

    printk("  AD type: 0x%02x (%s), len: %u, data: ", data->type, ad_type_str(data->type),
           data->data_len);
    print_hex_bytes(data->data, data->data_len);
    printk("\n");

    switch (data->type) {
    case BT_DATA_NAME_COMPLETE:
    case BT_DATA_NAME_SHORTENED:
        printk("    name: \"");
        for (uint8_t i = 0; i < data->data_len; i++) {
            printk("%c", data->data[i]);
        }
        printk("\"\n");
        break;

    case BT_DATA_FLAGS:
        if (data->data_len >= 1) {
            printk("    flags: 0x%02x\n", data->data[0]);
        }
        break;

    case BT_DATA_TX_POWER:
        if (data->data_len >= 1) {
            printk("    adv tx power: %d dBm\n", (int8_t)data->data[0]);
        }
        break;

    case BT_DATA_MANUFACTURER_DATA:
        if (data->data_len >= 2) {
            uint16_t company_id = data->data[0] | (data->data[1] << 8);
            printk("    company id: 0x%04x\n", company_id);
        }
        break;

    case BT_DATA_GAP_APPEARANCE:
        if (data->data_len >= 2) {
            uint16_t appearance = data->data[0] | (data->data[1] << 8);
            printk("    appearance: 0x%04x\n", appearance);
        }
        break;

    default:
        break;
    }

    return true;
}

/*
 * Prints detailed information about a scanned BLE advertisement.
 * The advertising payload is also parsed into individual AD fields.
 */
void print_node(const struct bt_le_scan_recv_info *info, struct net_buf_simple *buf)
{
    char addr[BT_ADDR_LE_STR_LEN];

    if (!info || !buf) {
        printk("print_node: null info/buf\n");
        return;
    }

    bt_addr_le_to_str(info->addr, addr, sizeof(addr));

    printk("\n========== BLE SCAN NODE ==========\n");
    printk("addr:          %s\n", addr);
    printk("rssi:          %d dBm\n", info->rssi);

    if (info->tx_power == BT_GAP_TX_POWER_INVALID) {
        printk("tx_power:      invalid/unknown\n");
    } else {
        printk("tx_power:      %d dBm\n", info->tx_power);
    }

    if (info->sid == BT_GAP_SID_INVALID) {
        printk("sid:           invalid/not present\n");
    } else {
        printk("sid:           %u\n", info->sid);
    }

    printk("adv_type:      0x%02x (%s)\n", info->adv_type, adv_type_str(info->adv_type));

    printk("adv_props:     0x%04x", info->adv_props);

    if (info->adv_props & BT_GAP_ADV_PROP_CONNECTABLE) {
        printk(" CONNECTABLE");
    }
    if (info->adv_props & BT_GAP_ADV_PROP_SCANNABLE) {
        printk(" SCANNABLE");
    }
    if (info->adv_props & BT_GAP_ADV_PROP_DIRECTED) {
        printk(" DIRECTED");
    }
    if (info->adv_props & BT_GAP_ADV_PROP_SCAN_RESPONSE) {
        printk(" SCAN_RESPONSE");
    }
    if (info->adv_props & BT_GAP_ADV_PROP_EXT_ADV) {
        printk(" EXT_ADV");
    }

    printk("\n");

    printk("primary_phy:   0x%02x (%s)\n", info->primary_phy, phy_str(info->primary_phy));
    printk("secondary_phy: 0x%02x (%s)\n", info->secondary_phy, phy_str(info->secondary_phy));

    if (info->interval == 0) {
        printk("periodic int:  none\n");
    } else {
        printk("periodic int:  %u units = %u us\n", info->interval, info->interval * 1250U);
    }

    printk("payload len:   %u\n", buf->len);
    printk("payload raw:   ");
    print_hex_bytes(buf->data, buf->len);
    printk("\n");

    printk("parsed AD fields:\n");

    /*
     * bt_data_parse() consumes from the buffer, so parse a shallow copy
     * and leave the original scan buffer unchanged.
     */
    struct net_buf_simple ad = *buf;
    bt_data_parse(&ad, print_ad_field, NULL);

    printk("===================================\n\n");
}

/*
 * BLE scan receive callback for sniffer mode.
 * All scanned packets are printed, while known nodes are also queued for processing.
 */
void scan_recv(const struct bt_le_scan_recv_info *info, struct net_buf_simple *buf)
{
    print_node(info, buf);

    if (!addr_match(info->addr)) {
        return;
    }

    struct scan_result result;
    bt_addr_le_copy(&result.addr, info->addr);
    result.rssi = info->rssi;

    k_msgq_put(&scan_msgq, &result, K_NO_WAIT);
}

/* Registers the receive callback used by Zephyr BLE scanning */
struct bt_le_scan_cb scan_callbacks = {
    .recv = scan_recv,
};

/*
 * Sniffer thread entry point.
 * The thread remains active while sniffer mode is enabled.
 */
void sniffer_thread(void *a, void *b, void *c)
{
    printk("Sniffer thread started\n");

    while (sniffer) {
        k_sleep(K_MSEC(1));
    }

    printk("Sniffer thread stopped\n");
}
```

## src/sniffer.h
```c
/*********************************** */
/*            sniffer.h              */
/*********************************** */
/* Authors                           */
/* Sidney Neil 47441952              */
/* Fiachra Richards  47450271        */
/*********************************** */

#ifndef SNIFFER_H
#define SNIFFER_H

#include <zephyr/kernel.h>
#include <zephyr/sys/printk.h>
#include <zephyr/bluetooth/bluetooth.h>
#include <zephyr/bluetooth/hci.h>
#include <zephyr/bluetooth/gap.h>

/* Thread configuration for BLE sniffer mode */
#define SNIFFER_PRIORITY   5
#define SNIFFER_STACK_SIZE 2048

/* Thread control block for the sniffer thread */
struct k_thread sniffer_thread_data;

/* Sniffer thread entry point */
void sniffer_thread(void *a, void *b, void *c);

/* BLE scan receive callback used while sniffing advertisements */
void scan_recv(const struct bt_le_scan_recv_info *info, struct net_buf_simple *buf);

/* Shared BLE scan callbacks registered by the central module */
extern struct bt_le_scan_cb scan_callbacks;

/* Message queue used to pass RSSI data from the sniffer */
extern struct k_msgq rssi_msgq;

#endif /* SNIFFER_H */
```
