## prj.conf
```kconfig
CONFIG_BT=y
CONFIG_BT_OBSERVER=y
CONFIG_BT_EXT_ADV=n
CONFIG_BT=y
CONFIG_BT_PERIPHERAL=y
CONFIG_BT_ZEPHYR_NUS=y
CONFIG_BT_DEVICE_NAME="mobile_node"
```

## src/main.c
```c
/*********************************** */
/*              main.c               */
/*********************************** */
/* Authors                           */
/* Sidney Neil 47441952              */
/* Fiachra Richards  47450271        */
/*********************************** */

/********* Include Libraries ******* */
#include <zephyr/sys/printk.h>
#include <zephyr/bluetooth/bluetooth.h>
#include <zephyr/kernel.h>

#include "sensor.h"
#include "comms.h"
/********************************* */

/*********** Global Defines ********** */

/* Thread configuration */
#define STACK_SIZE       2048
#define SENSING_PRIORITY 5
#define COMMS_PRIORITY   5

/* Thread entry functions defined in their respective modules */
extern void sensing_thread(void *a, void *b, void *c);
extern void comms_thread(void *a, void *b, void *c);

/* Stack areas for sensing and communication threads */
K_THREAD_STACK_DEFINE(sensing_stack, STACK_SIZE);
K_THREAD_STACK_DEFINE(comms_stack, STACK_SIZE);

/* Thread control blocks */
static struct k_thread sensing_thread_data;
static struct k_thread comms_thread_data;

int main(void)
{
    /* Start the sensing thread for collecting RSSI/sensor data */
    k_thread_create(&sensing_thread_data, sensing_stack, K_THREAD_STACK_SIZEOF(sensing_stack),
                    sensing_thread, NULL, NULL, NULL, SENSING_PRIORITY, 0, K_NO_WAIT);

    /* Start the communications thread for sending collected data over BLE */
    k_thread_create(&comms_thread_data, comms_stack, K_THREAD_STACK_SIZEOF(comms_stack),
                    comms_thread, NULL, NULL, NULL, COMMS_PRIORITY, 0, K_NO_WAIT);

    return 0;
}
```

## src/comms.c
```c
/*********************************** */
/*             comms.c               */
/*********************************** */
/* Authors                           */
/* Sidney Neil 47441952              */
/* Fiachra Richards  47450271        */
/*********************************** */

/********* Include Libraries ******* */
#include <zephyr/kernel.h>
#include <zephyr/bluetooth/bluetooth.h>
#include <zephyr/bluetooth/services/nus.h>
#include "comms.h"
#include "sensor.h"
/********************************* */

/*********** Global Defines ********** */

/* BLE advertising configuration */
#define DEVICE_NAME       CONFIG_BT_DEVICE_NAME
#define DEVICE_NAME_LEN   (sizeof(DEVICE_NAME) - 1)
#define MESSAGE_WAIT_TIME 1

/* Work queue item used to restart advertising after disconnection */
static struct k_work adv_wq;

int init_comms(void);
int send_comms(int8_t *data, uint16_t len);
static void adv_wq_handler(struct k_work *work);

/* Primary BLE advertising data */
static const struct bt_data ad[] = {
    BT_DATA_BYTES(BT_DATA_FLAGS, (BT_LE_AD_GENERAL | BT_LE_AD_NO_BREDR)),
    BT_DATA(BT_DATA_NAME_COMPLETE, DEVICE_NAME, DEVICE_NAME_LEN),
};

/* Scan response data advertising the Nordic UART Service UUID */
static const struct bt_data sd[] = {
    BT_DATA_BYTES(BT_DATA_UUID128_ALL, BT_UUID_NUS_SRV_VAL),
};

/* Callback triggered when NUS notifications are enabled or disabled */
static void notif_enabled(bool enabled, void *ctx)
{
    ARG_UNUSED(ctx);

    printk("%s() - %s\n", __func__, (enabled ? "Enabled" : "Disabled"));
}

/* Callback triggered when data is received over NUS */
static void received(struct bt_conn *conn, const void *data, uint16_t len, void *ctx)
{
    ARG_UNUSED(conn);
    ARG_UNUSED(ctx);

    printk("%s() - Len: %d, Message: %.*s\n", __func__, len, len, (char *)data);
}

/* Nordic UART Service callback registration */
struct bt_nus_cb nus_listener = {
    .notif_enabled = notif_enabled,
    .received = received,
};

/*
 * Initialises BLE communication.
 * Registers the NUS callbacks and starts connectable BLE advertising.
 */
int init_comms(void)
{
    int err;

    k_work_init(&adv_wq, adv_wq_handler);

    err = bt_nus_cb_register(&nus_listener, NULL);
    if (err) {
        printk("NUS register failed (err %d)\n", err);
        return err;
    }

    err = bt_le_adv_start(BT_LE_ADV_CONN_FAST_1, ad, ARRAY_SIZE(ad), sd, ARRAY_SIZE(sd));
    if (err) {
        printk("Advertising failed (err %d)\n", err);
        return err;
    }

    printk("Advertising as %s...\n", DEVICE_NAME);
    return 0;
}

/*
 * Sends RSSI data over the Nordic UART Service.
 * If no central device is connected, the function exits without treating it as fatal.
 */
int send_comms(int8_t *data, uint16_t len)
{
    int err;

    err = bt_nus_send(NULL, data, len);

    if (err == -ENOTCONN) {
        printk("Data not sent: No central connected.\n");
        return 0;
    } else if (err < 0) {
        printk("BT Send error: %d\n", err);
        return err;
    }

    printk("Data sent: ");
    for (int i = 0; i < len; i++) {
        printk("%d ", data[i]);
    }
    printk("\n");

    return 0;
}

/*
 * Communication thread.
 * Waits for RSSI data from the sensor/scanner queue and sends it over BLE.
 */
void comms_thread(void *a, void *b, void *c)
{
    int8_t rssi_table[13];

    init_comms();

    while (1) {
        // Wait for data from the sensor/scanner
        k_msgq_get(&rssi_msgq, &rssi_table, K_FOREVER);

        // Use the updated function with explicit length
        send_comms((int8_t *)rssi_table, sizeof(rssi_table));
    }
}

/* Restarts BLE advertising after a connection is lost */
static void adv_wq_handler(struct k_work *work)
{
    int err = bt_le_adv_start(BT_LE_ADV_CONN_FAST_1, ad, ARRAY_SIZE(ad), sd, ARRAY_SIZE(sd));
    if (err) {
        printk("Failed to restart advertising (err %d)\n", err);
    } else {
        printk("Advertising restarted\n");
    }
}

/* Handles BLE disconnection events */
static void on_disconnected(struct bt_conn *conn, uint8_t reason)
{
    printk("Disconnected (reason %d)\n", reason);
    k_work_submit(&adv_wq);
}

/* Handles BLE connection events */
static void on_connected(struct bt_conn *conn, uint8_t err)
{
    if (err) {
        printk("Connection failed (err %d)\n", err);
        return;
    }

    printk("Connected\n");
}

/* Register BLE connection callbacks */
BT_CONN_CB_DEFINE(conn_callbacks) = {
    .connected = on_connected,
    .disconnected = on_disconnected,
};
```

## src/comms.h
```c
/*********************************** */
/*             comms.h               */
/*********************************** */
/* Authors                           */
/* Sidney Neil 47441952              */
/* Fiachra Richards  47450271        */
/*********************************** */

#ifndef COMMS_H
#define COMMS_H

#include <stdint.h>
#include <zephyr/types.h>

/* Initialises BLE communication and starts advertising */
int init_comms(void);

/* Sends a data buffer over BLE, with the payload length passed explicitly */
int send_comms(int8_t *data, uint16_t len);

/* Thread entry point for sending queued RSSI data over BLE */
void comms_thread(void *a, void *b, void *c);

#endif /* COMMS_H */
```

## src/sensor.c
```c
/*********************************** */
/*             sensor.c              */
/*********************************** */
/* Authors                           */
/* Sidney Neil 47441952              */
/* Fiachra Richards  47450271        */
/*********************************** */

/********* Include Libraries ******* */
#include <zephyr/sys/printk.h>
#include <zephyr/bluetooth/bluetooth.h>
#include <zephyr/bluetooth/hci.h>
#include <zephyr/bluetooth/gap.h>
#include <string.h>

#include "sensor.h"
/********************************* */

/*********** Global Defines ********** */

#define NAME_LEN        30
#define NODE_TIMEOUT_MS 3000

/* Known BLE beacon node addresses used for RSSI scanning */
static const bt_addr_le_t nodelist[] = {
    {.type = BT_ADDR_LE_RANDOM, .a = {{0x67, 0x34, 0x85, 0xFE, 0x75, 0xF5}}},
    {.type = BT_ADDR_LE_RANDOM, .a = {{0x86, 0x1E, 0x06, 0x87, 0x73, 0xE5}}},
    {.type = BT_ADDR_LE_RANDOM, .a = {{0xB1, 0x98, 0xFD, 0x9E, 0x99, 0xCA}}},
    {.type = BT_ADDR_LE_RANDOM, .a = {{0xFE, 0xFF, 0x82, 0x89, 0x1B, 0xCB}}},
    {.type = BT_ADDR_LE_RANDOM, .a = {{0xAC, 0x5C, 0xA4, 0xA0, 0xD2, 0xD4}}},
    {.type = BT_ADDR_LE_RANDOM, .a = {{0x7C, 0xB7, 0xE9, 0x27, 0x13, 0xC1}}},
    {.type = BT_ADDR_LE_RANDOM, .a = {{0xA0, 0x39, 0x06, 0x48, 0x04, 0xF1}}},
    {.type = BT_ADDR_LE_RANDOM, .a = {{0x60, 0xCE, 0xDB, 0xE0, 0x0C, 0xCA}}},
    {.type = BT_ADDR_LE_RANDOM, .a = {{0x13, 0x20, 0x7C, 0xD4, 0x7F, 0xD4}}},
    {.type = BT_ADDR_LE_RANDOM, .a = {{0xE1, 0xC8, 0xF1, 0x21, 0x0B, 0xF7}}},
    {.type = BT_ADDR_LE_RANDOM, .a = {{0x4A, 0x3E, 0xFA, 0x8D, 0xE0, 0xFD}}},
    {.type = BT_ADDR_LE_RANDOM, .a = {{0xAC, 0xFA, 0x28, 0xF7, 0x32, 0xEE}}},
    {.type = BT_ADDR_LE_RANDOM, .a = {{0x2C, 0xD7, 0xA8, 0x46, 0x3B, 0xF7}}},
};

/* Stores one scanned beacon address and its RSSI reading */
struct scan_result {
    bt_addr_le_t addr;
    int8_t rssi;
};

/* Queues for scan results and the current RSSI table */
K_MSGQ_DEFINE(scan_msgq, sizeof(struct scan_result), 30, 4);
K_MSGQ_DEFINE(rssi_msgq, 13 * sizeof(int8_t), 1, 4);

/* Checks whether a scanned address is one of the configured beacon nodes */
static bool addr_match(const bt_addr_le_t *addr)
{
    for (int i = 0; i < ARRAY_SIZE(nodelist); i++) {
        if (bt_addr_le_cmp(addr, &nodelist[i]) == 0) {
            return true;
        }
    }

    return false;
}

/* Returns the table index for a known beacon address */
static int addr_index(const bt_addr_le_t *addr)
{
    for (int i = 0; i < ARRAY_SIZE(nodelist); i++) {
        if (bt_addr_le_cmp(addr, &nodelist[i]) == 0) {
            return i;
        }
    }

    return -1;
}

/*
 * BLE scan receive callback.
 * Valid beacon advertisements are copied into the scan queue for processing.
 */
static void scan_recv(const struct bt_le_scan_recv_info *info, struct net_buf_simple *buf)
{
    if (!addr_match(info->addr)) {
        return;
    }

    struct scan_result result;
    bt_addr_le_copy(&result.addr, info->addr);
    result.rssi = info->rssi;

    k_msgq_put(&scan_msgq, &result, K_NO_WAIT);
}

/* Scan callback registration used by the Zephyr BLE stack */
static struct bt_le_scan_cb scan_callbacks = {
    .recv = scan_recv,
};

/*
 * Sensing thread.
 * Scans for known BLE beacons, updates the RSSI table, and queues the latest
 * values for the communications thread.
 */
void sensing_thread(void *a, void *b, void *c)
{
    bt_enable(NULL);

    struct bt_le_scan_param scan_param = {
        .type = BT_LE_SCAN_TYPE_PASSIVE,
        .options = BT_LE_SCAN_OPT_FILTER_DUPLICATE,
        .interval = 0x0100,
        .window = BT_GAP_SCAN_FAST_WINDOW,
    };

    struct scan_result result;

    int8_t rssi_table[13] = {0};
    int64_t last_seen[13] = {0};

    bt_le_scan_cb_register(&scan_callbacks);
    bt_le_scan_start(&scan_param, NULL);

    while (1) {
        int err = k_msgq_get(&scan_msgq, &result, K_FOREVER);

        if (!err) {
            int i = addr_index(&result.addr);
            if (i != -1) {
                rssi_table[i] = result.rssi;
                last_seen[i] = k_uptime_get();
            }
        }

        uint64_t curr_time = k_uptime_get();

        /* Clear RSSI values for beacons that have not been seen recently */
        for (int i = 0; i < 13; i++) {
            if (last_seen[i] != 0 && (curr_time - last_seen[i]) > NODE_TIMEOUT_MS) {
                rssi_table[i] = 0;
                last_seen[i] = 0;
            }
        }

        k_msgq_put(&rssi_msgq, &rssi_table, K_NO_WAIT);
    }
}
```

## src/sensor.h
```c
/*********************************** */
/*             sensor.h              */
/*********************************** */
/* Authors                           */
/* Sidney Neil 47441952              */
/* Fiachra Richards  47450271        */
/*********************************** */

#ifndef SENSOR_H
#define SENSOR_H

#include <zephyr/kernel.h>

/* Thread entry point for scanning known BLE beacons and collecting RSSI data */
void sensing_thread(void *a, void *b, void *c);

/* Shared queue containing the latest RSSI table for the communications thread */
extern struct k_msgq rssi_msgq;

#endif /* SENSOR_H */
```
